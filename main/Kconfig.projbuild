## main/Kconfig.projbuild
```kconfig
# SPDX-License-Identifier: MIT
menu "Secure OTA configuration"

    config OTA_MANIFEST_URL
        string "OTA manifest URL (HTTPS)"
        default "https://localhost:8443/manifest.json"
        help
            Full HTTPS URL of the release manifest. The device fetches this
            JSON document, compares its version with the running app, and only
            then performs an OTA update of the referenced firmware image.

    config WIFI_SSID
        string "Wi-Fi SSID"
        default "CHANGE_ME"
        help
            Station SSID used for the demo update flow.

    config WIFI_PASSWORD
        string "Wi-Fi password"
        default "CHANGE_ME"
        help
            Station password. For anything beyond a local demo, provision this
            at runtime instead of hard-coding it.

    config APP_SELF_TEST_FAIL
        bool "Force the post-update self-test to fail (rollback test)"
        default n
        help
            Development-only switch. When enabled, the first boot of a new
            image fails its self-test so the bootloader rolls back to the
            previous image. Use it to exercise the rollback path on a board;
            never enable it in a release build.

endmenu
```
